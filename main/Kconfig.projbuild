## main/Kconfig.projbuild
```kconfig
menu "LilGuy Eyes"

config LILGUY_FRAME_RATE
    int "Target frame rate"
    range 20 60
    default 60
    help
        Procedural animation frame rate. 60 fps matches the client render loop.

config LILGUY_ROUND_VIEWPORT
    bool "Mask rendering to a circular viewport"
    default y
    help
        Keeps the visual composition compatible with round Lil Guy displays.
        The physical Waveshare panel is square with rounded corners.

config LILGUY_SHOW_SELECTION_OVERLAY
    bool "Show the selected look after a swipe"
    default y

config LILGUY_IMU_AUTOCALIBRATE
    bool "Auto-calibrate tilt neutral on first boot"
    default y

config LILGUY_WORLD_VIEW
    bool "World-view browse carousel (hex palette grid)"
    default n
    help
        Compiles in the drag-to-browse infinite hex palette grid (fisheye
        world view with fling/settle selection). Off: drags are pure gaze
        follow, grid_visibility stays 0, and the grid renderer/cache code
        is removed from the binary. Host builds keep it on (Makefile).

endmenu
```

## sdkconfig.defaults
```kconfig
CONFIG_IDF_TARGET="esp32s3"
CONFIG_ESPTOOLPY_FLASHMODE_DIO=y
CONFIG_ESPTOOLPY_FLASHSIZE_32MB=y
CONFIG_COMPILER_OPTIMIZATION_PERF=y
CONFIG_ESP_DEFAULT_CPU_FREQ_MHZ_240=y

CONFIG_SPIRAM=y
CONFIG_SPIRAM_MODE_OCT=y
CONFIG_SPIRAM_SPEED_80M=y
CONFIG_SPIRAM_FETCH_INSTRUCTIONS=y
CONFIG_SPIRAM_RODATA=y
CONFIG_SPIRAM_XIP_FROM_PSRAM=y

CONFIG_FREERTOS_HZ=1000
CONFIG_LV_OS_FREERTOS=y
CONFIG_LV_USE_CLIB_MALLOC=y
CONFIG_LV_USE_CLIB_STRING=y
CONFIG_LV_USE_CLIB_SPRINTF=y
CONFIG_LV_DEF_REFR_PERIOD=16
CONFIG_LV_OBJ_STYLE_CACHE=y
CONFIG_LV_DRAW_SW_DRAW_UNIT_CNT=2
CONFIG_LV_ATTRIBUTE_FAST_MEM_USE_IRAM=y
CONFIG_LV_FONT_MONTSERRAT_14=y
CONFIG_LV_FONT_MONTSERRAT_16=y
CONFIG_LV_FONT_MONTSERRAT_18=y
CONFIG_LV_USE_FONT_COMPRESSED=y
# CONFIG_LV_BUILD_EXAMPLES is not set
# CONFIG_LV_BUILD_DEMOS is not set
CONFIG_LV_DRAW_SW_SUPPORT_RGB565_SWAPPED=y
CONFIG_BSP_LCD_TRANS_QUEUE_DEPTH=3
CONFIG_ESP_MAIN_TASK_STACK_SIZE=8192
CONFIG_PARTITION_TABLE_CUSTOM=y
CONFIG_PARTITION_TABLE_CUSTOM_FILENAME="partitions.csv"
# Dual OTA slots: the bootloader keeps the previous image until the new one confirms
# (ota_service.cpp calls esp_ota_mark_app_valid_cancel_rollback).
CONFIG_BOOTLOADER_APP_ROLLBACK_ENABLE=y

# OS Basic: BLE on (NimBLE host) for Wi-Fi provisioning from the companion page / app.
CONFIG_BT_ENABLED=y
CONFIG_BT_NIMBLE_ENABLED=y
```
